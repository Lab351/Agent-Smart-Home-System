## room-agent/esp32_beacon_config/sdkconfig.defaults
```kconfig
# ESP-IDF SDK配置文件
# 对应Room Agent配置: config/room_agent.yaml

# 房间配置
CONFIG_ROOM_ID="bedroom"
CONFIG_ROOM_MAJOR=2
CONFIG_ROOM_MINOR=0

# BLE Beacon配置
CONFIG_BEACON_ENABLED=y
CONFIG_BEACON_INTERVAL=1

# WiFi配置（根据实际网络修改）
CONFIG_ESP_WIFI_SSID="YourWiFiSSID"
CONFIG_ESP_WIFI_PASSWORD="YourWiFiPassword"

# MQTT配置（可选：ESP32作为MQTT客户端）
CONFIG_MQTT_ENABLED=n
# CONFIG_MQTT_BROKER_URI="mqtt://192.168.1.100:1883"

# 日志级别
CONFIG_LOG_DEFAULT_LEVEL_INFO=1
```
